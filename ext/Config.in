## ext/Config.in
```kconfig
source "$BR2_EXTERNAL_SURESHOT_PATH/package/mpf/Config.in"
source "$BR2_EXTERNAL_SURESHOT_PATH/package/python-psutil-v573/Config.in"
source "$BR2_EXTERNAL_SURESHOT_PATH/package/python-pyserial/Config.in"
source "$BR2_EXTERNAL_SURESHOT_PATH/package/python-pyserial-asyncio-v5/Config.in"
source "$BR2_EXTERNAL_SURESHOT_PATH/package/python-sortedcontainers-v23/Config.in"
source "$BR2_EXTERNAL_SURESHOT_PATH/package/sureshot/Config.in"
```

## ext/configs/sureshot_defconfig
```kconfig
BR2_arm=y
BR2_cortex_a72=y
BR2_ARM_FPU_NEON_VFPV4=y
BR2_PACKAGE_HOST_LINUX_HEADERS_CUSTOM_5_10=y
BR2_TOOLCHAIN_BUILDROOT_WCHAR=y
BR2_TOOLCHAIN_BUILDROOT_CXX=y
BR2_CCACHE=y
BR2_TARGET_GENERIC_HOSTNAME="sureshot"
BR2_TARGET_GENERIC_ISSUE="Welcome to Sure Shot Modern Pinball!"
BR2_ROOTFS_DEVICE_TABLE="system/device_table.txt ext/configs/device_table.txt"
BR2_TARGET_GENERIC_ROOT_PASSWD="sureshot"
# BR2_TARGET_GENERIC_REMOUNT_ROOTFS_RW is not set
BR2_SYSTEM_DHCP="eth0"
BR2_ROOTFS_OVERLAY="ext/overlay"
BR2_ROOTFS_POST_BUILD_SCRIPT="board/raspberrypi4/post-build.sh"
BR2_ROOTFS_POST_IMAGE_SCRIPT="board/raspberrypi4/post-image.sh"
BR2_LINUX_KERNEL=y
BR2_LINUX_KERNEL_CUSTOM_TARBALL=y
BR2_LINUX_KERNEL_CUSTOM_TARBALL_LOCATION="$(call github,raspberrypi,linux,0b54dbda3cca2beb51e236a25738784e90853b64)/linux-0b54dbda3cca2beb51e236a25738784e90853b64.tar.gz"
BR2_LINUX_KERNEL_DEFCONFIG="bcm2711"
BR2_LINUX_KERNEL_CONFIG_FRAGMENT_FILES="ext/configs/kernel_defconfig"
BR2_LINUX_KERNEL_DTS_SUPPORT=y
BR2_LINUX_KERNEL_INTREE_DTS_NAME="bcm2711-rpi-4-b"
BR2_LINUX_KERNEL_NEEDS_HOST_OPENSSL=y
BR2_PACKAGE_BUSYBOX_CONFIG="ext/configs/busybox.config"
BR2_PACKAGE_NFS_UTILS=y
BR2_PACKAGE_RPI_FIRMWARE=y
BR2_PACKAGE_RPI_FIRMWARE_VARIANT_PI4=y
BR2_PACKAGE_RPI_FIRMWARE_CONFIG_FILE="ext/configs/config.txt"
BR2_PACKAGE_PYTHON3=y
BR2_PACKAGE_PYTHON3_PY_PYC=y
BR2_PACKAGE_DROPBEAR=y
# BR2_PACKAGE_DROPBEAR_CLIENT is not set
BR2_PACKAGE_DROPBEAR_DISABLE_REVERSEDNS=y
BR2_PACKAGE_NANO=y
BR2_TARGET_ROOTFS_EXT2=y
BR2_TARGET_ROOTFS_EXT2_4=y
BR2_TARGET_ROOTFS_EXT2_SIZE="250M"
# BR2_TARGET_ROOTFS_TAR is not set
BR2_PACKAGE_HOST_DOSFSTOOLS=y
BR2_PACKAGE_HOST_GENIMAGE=y
BR2_PACKAGE_HOST_MTOOLS=y
BR2_PACKAGE_SURESHOT=y
```

## ext/package/mpf/Config.in
```kconfig
config BR2_PACKAGE_MPF
	bool "mpf"
	select BR2_PACKAGE_PYTHON_PACKAGING # runtime
	select BR2_PACKAGE_PYTHON_PSUTIL_V573 # runtime
	select BR2_PACKAGE_PYTHON_PYPARSING # runtime
	select BR2_PACKAGE_PYTHON_PYSERIAL # runtime
	select BR2_PACKAGE_PYTHON_PYSERIAL_ASYNCIO_V5 # runtime
	select BR2_PACKAGE_PYTHON_SETUPTOOLS # runtime, pkg_resources
	select BR2_PACKAGE_PYTHON_SORTEDCONTAINERS_V23 # runtime
	help
	  Mission Pinball Framework.

	  https://missionpinball.org
```

## ext/package/python-psutil-v573/Config.in
```kconfig
config BR2_PACKAGE_PYTHON_PSUTIL_V573
	bool "python-psutil-v573"
	help
	  psutil is a cross-platform library for retrieving
	  information on running processes and system utilization
	  (CPU, memory, disks, network) in Python.

	  https://pypi.python.org/pypi/psutil
```

## ext/package/python-pyserial-asyncio-v5/Config.in
```kconfig
config BR2_PACKAGE_PYTHON_PYSERIAL_ASYNCIO_V5
	bool "python-pyserial-asyncio-v5"
	select BR2_PACKAGE_PYTHON_PYSERIAL # runtime
	help
	  Python Serial Port Extension - Asynchronous I/O support.

	  https://github.com/pyserial/pyserial-asyncio
```

## ext/package/python-sortedcontainers-v23/Config.in
```kconfig
config BR2_PACKAGE_PYTHON_SORTEDCONTAINERS_V23
	bool "python-sortedcontainers-v23"
	help
	  Python Sorted Container Types: SortedList, SortedDict, and
	  SortedSet.

	  http://www.grantjenks.com/docs/sortedcontainers/
```

## ext/package/sureshot/Config.in
```kconfig
config BR2_PACKAGE_SURESHOT
	bool "sureshot"
    select BR2_PACKAGE_MPF # runtime

	help
	  Source code for SureShot Pinball
```
